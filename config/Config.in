## config/Config.in
```kconfig
source "$BR2_EXTERNAL/packages/consul/Config.in"
source "$BR2_EXTERNAL/packages/defgrid-init/Config.in"
```

## config/configs/defgrid_common_defconfig
```kconfig
BR2_x86_64=y
BR2_TOOLCHAIN_EXTERNAL=y
BR2_TOOLCHAIN_EXTERNAL_CUSTOM=y
BR2_TOOLCHAIN_EXTERNAL_PATH="$(DG_TOOLCHAIN_SYSROOT)"
BR2_TOOLCHAIN_EXTERNAL_CUSTOM_PREFIX="x86_64-defgrid-linux-uclibc"
BR2_TOOLCHAIN_EXTERNAL_GCC_4_9=y
BR2_TOOLCHAIN_EXTERNAL_HEADERS_4_7=y
BR2_TOOLCHAIN_EXTERNAL_LOCALE=y
# BR2_TOOLCHAIN_EXTERNAL_HAS_THREADS_DEBUG is not set
BR2_TOOLCHAIN_EXTERNAL_HAS_SSP=y
BR2_TOOLCHAIN_EXTERNAL_CXX=y
BR2_TARGET_GENERIC_HOSTNAME="defgrid"
BR2_TARGET_GENERIC_ISSUE="Defgrid Linux"
BR2_TARGET_GENERIC_PASSWD_SHA512=y
# BR2_TARGET_ENABLE_ROOT_LOGIN is not set
# BR2_TARGET_GENERIC_GETTY is not set
BR2_SYSTEM_DHCP="eth0"
BR2_TARGET_TZ_INFO=y
BR2_ROOTFS_USERS_TABLES="$(BR2_EXTERNAL)/common/system_users"
BR2_ROOTFS_OVERLAY="$(BR2_EXTERNAL)/common/rootfs_overlay"
BR2_LINUX_KERNEL=y
BR2_LINUX_KERNEL_USE_ARCH_DEFAULT_CONFIG=y
BR2_PACKAGE_DHCPCD=y
BR2_PACKAGE_DNSMASQ=y
# BR2_PACKAGE_DNSMASQ_TFTP is not set
# BR2_PACKAGE_DNSMASQ_DHCP is not set
BR2_PACKAGE_DROPBEAR=y
# BR2_PACKAGE_DROPBEAR_CLIENT is not set
BR2_PACKAGE_DROPBEAR_DISABLE_REVERSEDNS=y
# BR2_PACKAGE_DROPBEAR_SMALL is not set
BR2_PACKAGE_IPUTILS=y
BR2_PACKAGE_NTP=y
BR2_PACKAGE_NTP_NTPDATE=y
BR2_PACKAGE_FILE=y
BR2_PACKAGE_SUDO=y
BR2_PACKAGE_UTIL_LINUX=y
BR2_PACKAGE_NANO=y
# BR2_PACKAGE_NANO_TINY is not set
BR2_TARGET_ROOTFS_EXT2=y
BR2_TARGET_ROOTFS_EXT2_3=y
BR2_TARGET_ROOTFS_EXT2_LABEL="defgrid"
# BR2_TARGET_ROOTFS_TAR is not set
BR2_TARGET_SYSLINUX=y
BR2_TARGET_SYSLINUX_MBR=y
```

## config/packages/consul/Config.in
```kconfig
config BR2_PACKAGE_CONSUL
	bool "consul"
	depends on BR2_PACKAGE_HOST_GO_ARCH_SUPPORTS
	depends on BR2_PACAKGE_HOST_GO_CGO_LINKING_SUPPORTS
	depends on BR2_TOOLCHAIN_HAS_THREADS
	depends on BR2_USE_MMU
	depends on BR2_USE_WCHAR
	help
	  Service discovery and configuration storage solution from Hashicorp.

	  https://www.consul.io/

comment "consul needs a toolchain w/ threads, wchar"
	depends on BR2_PACKAGE_HOST_GO_ARCH_SUPPORTS
	depends on BR2_PACKAGE_HOST_GO_CGO_LINKING_SUPPORTS
	depends on BR2_USE_MMU
	depends on !BR2_TOOLCHAIN_HAS_THREADS || !BR2_USE_WCHAR
```

## config/packages/defgrid-confont/Config.in
```kconfig
config BR2_PACKAGE_DEFGRID_CONFONT
	bool "defgrid-confont"
	select BR2_PACKAGE_HOST_DG_KBD
	select BR2_PACAKGE_HOST_NAFE
	help
	  defgrid VGA text-mode console font
```

## config/packages/defgrid-init/Config.in
```kconfig
config BR2_PACKAGE_DEFGRID_INIT
	bool "defgrid-init"
	depends on BR2_PACKAGE_HOST_GO_ARCH_SUPPORTS
	depends on BR2_PACAKGE_HOST_GO_CGO_LINKING_SUPPORTS
	depends on BR2_TOOLCHAIN_HAS_THREADS
	depends on BR2_USE_MMU
	depends on BR2_USE_WCHAR
	select BR2_PACKAGE_HAVEGED
	help
	  defgrid-specific /sbin/init

comment "defgrid-init needs a toolchain w/ threads, wchar"
	depends on BR2_PACKAGE_HOST_GO_ARCH_SUPPORTS
	depends on BR2_PACKAGE_HOST_GO_CGO_LINKING_SUPPORTS
	depends on BR2_USE_MMU
	depends on !BR2_TOOLCHAIN_HAS_THREADS || !BR2_USE_WCHAR
```

## config/packages/nafe/Config.in.host
```kconfig
config BR2_PACKAGE_HOST_NAFE
	bool "host nafe"
	help
	  Produce PSF linux console fonts from plain text source files.

	  http://nafe.sourceforge.net/
```
